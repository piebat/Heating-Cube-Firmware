## main/Kconfig.projbuild
```kconfig
menu "Heating controller"

    config HEATING_WIFI_SSID
        string "Wi-Fi SSID"
        default "myssid"

    config HEATING_WIFI_PASSWORD
        string "Wi-Fi password"
        default "mypassword"

    config HEATING_MQTT_URI
        string "MQTT broker URI"
        default "mqtt://192.168.1.10:1883"
        help
            For example mqtt://host:1883 or mqtts://host:8883.

    config HEATING_MAX_TEMP_C
        int "Safety cut-out temperature (degC)"
        default 120
        help
            The heater is forced off above this reading and stays off
            until the temperature drops back below it.

endmenu
```

## sdkconfig.defaults
```kconfig
CONFIG_IDF_TARGET="esp32s3"

# Heating controller
CONFIG_HEATING_WIFI_SSID="YourNetwork"
CONFIG_HEATING_WIFI_PASSWORD="YourPassword"
CONFIG_HEATING_MQTT_URI="mqtt://192.168.1.50:1883"
CONFIG_HEATING_MAX_TEMP_C=120
```
